## configs/minidisc_defconfig
```kconfig
# Target options
BR2_arm=y

# System configuration
BR2_TARGET_GENERIC_HOSTNAME="minidisc"
BR2_TARGET_GENERIC_ISSUE="Welcome to befis Minidisc player"
BR2_TARGET_GENERIC_GETTY_PORT="ttyS0"
BR2_TARGET_GENERIC_GETTY_BAUDRATE_115200=y
BR2_ROOTFS_POST_IMAGE_SCRIPT="support/scripts/genimage.sh"
BR2_ROOTFS_POST_SCRIPT_ARGS="-c $(BR2_EXTERNAL_MINIDISC_PATH)/board/minidisc/genimage.cfg"

# Kernel
BR2_LINUX_KERNEL=y
BR2_PACKAGE_HOST_LINUX_HEADERS_CUSTOM_5_4=y
BR2_LINUX_KERNEL_CUSTOM_VERSION=y
BR2_LINUX_KERNEL_CUSTOM_VERSION_VALUE="5.4.92"
BR2_LINUX_KERNEL_DTS_SUPPORT=y
BR2_LINUX_KERNEL_USE_CUSTOM_CONFIG=y
BR2_LINUX_KERNEL_PATCH="$(BR2_EXTERNAL_MINIDISC_PATH)/board/minidisc/patch/linux"
BR2_LINUX_KERNEL_CUSTOM_CONFIG_FILE="$(BR2_EXTERNAL_MINIDISC_PATH)/board/minidisc/linux.defconfig"
BR2_LINUX_KERNEL_CUSTOM_DTS_PATH="$(BR2_EXTERNAL_MINIDISC_PATH)/board/minidisc/devicetree/suniv-f1c100s.dtsi $(BR2_EXTERNAL_MINIDISC_PATH)/board/minidisc/devicetree/devicetree.dts"

# Filesystem images
BR2_TARGET_ROOTFS_EXT2=y
BR2_TARGET_ROOTFS_EXT2_4=y
BR2_TARGET_ROOTFS_EXT2_SIZE="100M"

BR2_ROOTFS_OVERLAY="$(BR2_EXTERNAL_MINIDISC_PATH)/board/minidisc/overlay"

# Bootloaders
BR2_TARGET_UBOOT=y
BR2_TARGET_UBOOT_BUILD_SYSTEM_KCONFIG=y
BR2_TARGET_UBOOT_CUSTOM_VERSION=y
BR2_TARGET_UBOOT_CUSTOM_VERSION_VALUE="2023.04"
BR2_TARGET_UBOOT_BOARD_DEFCONFIG="licheepi_nano"
BR2_TARGET_UBOOT_CONFIG_FRAGMENT_FILES="$(BR2_EXTERNAL_MINIDISC_PATH)/board/minidisc/uboot.fragment"
BR2_TARGET_UBOOT_SPL=y
BR2_TARGET_UBOOT_SPL_NAME="u-boot-sunxi-with-spl.bin"
BR2_TARGET_UBOOT_NEEDS_DTC=y
BR2_TARGET_UBOOT_NEEDS_PYLIBFDT=y
BR2_TARGET_UBOOT_NEEDS_OPENSSL=y

# Required host utilities
BR2_PACKAGE_HOST_DOSFSTOOLS=y
BR2_PACKAGE_HOST_E2FSPROGS=y
BR2_PACKAGE_HOST_GENIMAGE=y
BR2_PACKAGE_HOST_MTOOLS=y
BR2_PACKAGE_HOST_SUNXI_TOOLS=y

BR2_PACKAGE_ALSA_UTILS=y
BR2_PACKAGE_ALSA_UTILS_ALSACTL=y
BR2_PACKAGE_ALSA_UTILS_ALSAMIXER=y
BR2_PACKAGE_ALSA_UTILS_AMIXER=y
BR2_PACKAGE_ALSA_UTILS_APLAY=y
BR2_PACKAGE_ALSA_UTILS_SPEAKER_TEST=y
BR2_PACKAGE_ALSA_LIB=y
BR2_PACKAGE_ALSA_LIB_DEVDIR="/dev/snd"
BR2_PACKAGE_ALSA_LIB_PCM_PLUGINS="all"
BR2_PACKAGE_ALSA_LIB_CTL_PLUGINS="all"
BR2_PACKAGE_ALSA_LIB_ALOAD=y
BR2_PACKAGE_ALSA_LIB_MIXER=y
BR2_PACKAGE_ALSA_LIB_PCM=y
BR2_PACKAGE_ALSA_LIB_RAWMIDI=y
BR2_PACKAGE_ALSA_LIB_HWDEP=y
BR2_PACKAGE_ALSA_LIB_SEQ=y
BR2_PACKAGE_ALSA_LIB_UCM=y
BR2_PACKAGE_ALSA_LIB_ALISP=y
BR2_PACKAGE_ALSA_LIB_OLD_SYMBOLS=y
BR2_PACKAGE_TINYALSA=y
BR2_PACKAGE_MPG123=y
BR2_PACKAGE_SCREEN=y
BR2_PACKAGE_VMTOUCH=y

BR2_GENERATE_LOCALE="en_US.UTF-8"
BR2_PACKAGE_SPIDEV_TEST=y
BR2_PACKAGE_LRZSZ=y
```

## package/minidisc/Config.in
```kconfig
config BR2_PACKAGE_MINIDISC
	bool minidisc
	select BR2_PACKAGE_LIBGPIOD
	select BR2_PACKAGE_MPG123
	select BR2_PACKAGE_FREETYPE
	select BR2_PACKAGE_GD
	select BR2_PACKAGE_DEJAVU
	select BR2_PACKAGE_DEJAVU_SANS
```
